## cat-bridge/sdkconfig.defaults
```kconfig
# ESP-IDF sdkconfig defaults for cat-bridge

# CPU frequency
CONFIG_ESP_DEFAULT_CPU_FREQ_MHZ=240

# USB
CONFIG_USB_OTG_SUPPORTED=y
CONFIG_TINYUSB=y
CONFIG_TINYUSB_CDC=y

# UART
CONFIG_UART_ISR_IN_IRAM=y

# Watchdog
CONFIG_ESP_INT_WDT=y
CONFIG_ESP_INT_WDT_TIMEOUT_MS=300
CONFIG_ESP_TASK_WDT_EN=y
CONFIG_ESP_TASK_WDT_TIMEOUT_S=5

# Logging
CONFIG_LOG_DEFAULT_LEVEL_INFO=y
```
